ORG 0H

ACALL SETUP
LJMP KEYBOARD_LOOP	

SETUP:
	MOV A,#38H	;TWO LINES, 5X7 MATRIX
	ACALL SEND_COMMAND
	MOV A,#0FH	;DISPLAY ON, CURSOR BLINKING
	ACALL SEND_COMMAND
	MOV A,#06H	;INCREMENT CURSOR (SHIFT CURSOR TO RIGHT)
	ACALL SEND_COMMAND
	MOV A,#01H	;CLEAR DISPLAY SCREEN
	ACALL SEND_COMMAND
	MOV A,#80H	;FORCE CURSOR TO BEGINNING OF THE FIRST LINE
	ACALL SEND_COMMAND
	RET

SEND_COMMAND:
	MOV P1,A
	CLR P3.5		;RS=0 BEFORE SENDING COMMAND
	CLR P3.6		;R/W=0 TO WRITE
	SETB P3.7	;SEND A HIGH TO LOW SIGNAL TO ENABLE PIN
	ACALL DELAY
	CLR P3.7
	RET
SEND_DATA:
	MOV P1,A
	SETB P3.5		;RS=0 BEFORE SENDING COMMAND
	CLR P3.6		;R/W=0 TO WRITE
	SETB P3.7	;SEND A HIGH TO LOW SIGNAL TO ENABLE PIN
	ACALL DELAY
	CLR P3.7
	RET
	
DELAY:	
	PUSH 0
	PUSH 1
	MOV R0,#50
DELAY_OUTER_LOOP:
	MOV R1,#255
	DJNZ R1,$
	DJNZ R0,DELAY_OUTER_LOOP
	POP 1
	POP 0
	RET

KEYBOARD_LOOP:
	
	ACALL KEYBOARD		; NOW A HAS THE KEY THAT IS PRESSED
	CJNE A,#02AH,NVM
		ACALL SETUP
		SJMP KEYBOARD_LOOP
	NVM:
	CJNE A,#023H,NVM2
		MOV A,#0C0H
		ACALL SEND_COMMAND
		SJMP KEYBOARD_LOOP
	NVM2:
	ACALL SEND_DATA 	; SEND DATA TO LCD SCREEN
	SJMP KEYBOARD_LOOP	; DOING ALL OVER AGAIN

KEYBOARD: ; takes the key pressed from the keyboard and puts it to A
	mov	P0, #0ffh	;makes P0 input
K1:
	mov	P2, #0	;ground all rows
	mov	A, P0
	anl	A, #00001111B
	cjne	A, #00001111B, K1
K2:
	acall	DELAY
	mov	A, P0
	anl	A, #00001111B
	cjne	A, #00001111B, KB_OVER
	sjmp	K2
KB_OVER:
	acall DELAY
	mov	A, P0
	anl	A, #00001111B
	cjne	A, #00001111B, KB_OVER1
	sjmp	K2
KB_OVER1:
	mov	P2, #11111110B
	mov	A, P0
	anl	A, #00001111B
	cjne	A, #00001111B, ROW_0
	mov	P2, #11111101B
	mov	A, P0
	anl	A, #00001111B
	cjne	A, #00001111B, ROW_1
	mov	P2, #11111011B
	mov	A, P0
	anl	A, #00001111B
	cjne	A, #00001111B, ROW_2
	mov	P2, #11110111B
	mov	A, P0
	anl	A, #00001111B
	cjne	A, #00001111B, ROW_3
	ljmp	K2
	
ROW_0:
	mov	DPTR, #KCODE0
	sjmp	KB_FIND
ROW_1:
	mov	DPTR, #KCODE1
	sjmp	KB_FIND
ROW_2:
	mov	DPTR, #KCODE2
	sjmp	KB_FIND
ROW_3:
	mov	DPTR, #KCODE3
KB_FIND:
	rrc	A
	jnc	KB_MATCH
	inc	DPTR
	sjmp	KB_FIND
KB_MATCH:
	clr	A
	movc	A, @A+DPTR; get ASCII code from the table 
	ret

;ASCII look-up table 
KCODE0:	DB	'1', '2', '3', 'A'
KCODE1:	DB	'4', '5', '6', 'B'
KCODE2:	DB	'7', '8', '9', 'C'
KCODE3:	DB	'*', '0', '#', 'D'


END: END
